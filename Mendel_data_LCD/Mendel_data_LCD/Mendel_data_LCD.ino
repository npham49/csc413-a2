#include <LiquidCrystal_I2C.h>

#include <Wire.h>

LiquidCrystal_I2C lcd(0x27,  16, 2);

int buttonPin = 7; 

int state = 0;
bool just_changed = true;
String f1_result;
String f2_result;

// Function to generate Punnett square and return all 16 offspring
// 16 slot matrix is generated by combining the 2 parents gametes
// Each gamete is a 2-character string, each character is an allele
// The gametes are combined in the following way:
// p1_gametes[0][0] + p2_gametes[0][0]
// p1_gametes[0][0] + p2_gametes[0][1]
// p1_gametes[0][1] + p2_gametes[0][0]
// p1_gametes[0][1] + p2_gametes[0][1]
void generatePunnettSquare(String parent1, String parent2, String offspring[16]) {
  // Extract alleles from parents
  char p1_a1 = parent1.charAt(0), p1_a2 = parent1.charAt(1);
  char p1_b1 = parent1.charAt(2), p1_b2 = parent1.charAt(3);
  char p2_a1 = parent2.charAt(0), p2_a2 = parent2.charAt(1);
  char p2_b1 = parent2.charAt(2), p2_b2 = parent2.charAt(3);
  
  // Generate all 16 combinations
  int index = 0;
  
  // Parent1 gametes: a1b1, a1b2, a2b1, a2b2
  // Parent2 gametes: a1b1, a1b2, a2b1, a2b2
  char p1_gametes[4][2] = {{p1_a1,p1_b1}, {p1_a1,p1_b2}, {p1_a2,p1_b1}, {p1_a2,p1_b2}};
  char p2_gametes[4][2] = {{p2_a1,p2_b1}, {p2_a1,p2_b2}, {p2_a2,p2_b1}, {p2_a2,p2_b2}};

  // Matrix calculation for creating the punett square
  // On each row we would add the 2 gametes together and then sort them by dominant first
  // Iterate over the rows
  for (int i = 0; i < 4; i++) {
    // Iterate over the collumns
    for (int j = 0; j < 4; j++) {
      String child = "";
      
      // Combine A alleles and sort (A before a)
      char a_alleles[2] = {p1_gametes[i][0], p2_gametes[j][0]};
      if (a_alleles[0] > a_alleles[1]) {
        char temp = a_alleles[0];
        a_alleles[0] = a_alleles[1];
        a_alleles[1] = temp;
      }
      
      // Combine B alleles and sort (B before b)
      char b_alleles[2] = {p1_gametes[i][1], p2_gametes[j][1]};
      if (b_alleles[0] > b_alleles[1]) {
        char temp = b_alleles[0];
        b_alleles[0] = b_alleles[1];
        b_alleles[1] = temp;
      }
      
      child += a_alleles[0];
      child += a_alleles[1];
      child += b_alleles[0];
      child += b_alleles[1];
      
      offspring[index] = child;
      index++;
    }
  }
}

// Function to calculate F2 phenotype ratios, get the matrix from generatePunnettSquare
// Calculate ratio through the following gene types:
// A_B_
// A_bb
// aaB_
// aabb
String calculateF2Ratio(String parent1, String parent2) {
  String offspring[16];
  generatePunnettSquare(parent1, parent2, offspring);
  
  // The 4 ratios
  int counts[4] = {0, 0, 0, 0}; // A_B_, A_bb, aaB_, aabb
  
  // Count phenotypes
  for (int i = 0; i < 16; i++) {
    String genotype = offspring[i];
    bool hasA = (genotype.charAt(0) == 'A' || genotype.charAt(1) == 'A');
    bool hasB = (genotype.charAt(2) == 'B' || genotype.charAt(3) == 'B');
    
    if (hasA && hasB) counts[0]++;      // A_B_
    else if (hasA && !hasB) counts[1]++; // A_bb
    else if (!hasA && hasB) counts[2]++; // aaB_
    else counts[3]++;                    // aabb
  }
  
  // Simple GCD calculation without recursion
  int gcd = counts[0];
  for (int i = 1; i < 4; i++) {
    if (counts[i] > 0) {
      int a = gcd, b = counts[i];
      while (b != 0) {
        int temp = b;
        b = a % b;
        a = temp;
      }
      gcd = a;
    }
  }
  
  if (gcd == 0) gcd = 1; // Prevent division by zero
  
  // Create ratio string
  String ratio = "";
  for (int i = 0; i < 4; i++) {
    ratio += String(counts[i] / gcd);
  }
  
  return ratio;
}

// Simple function to print results
void printResults(String parent1, String parent2) {
  Serial.println("Cross: " + parent1 + " × " + parent2);
  String ratio = calculateF2Ratio(parent1, parent2);
  Serial.println("F2 Ratio: " + ratio + " (A_B_:A_bb:aaB_:aabb)");
  Serial.println("------------------------");
}

// Take the first allele from each parent and return it as the first possible combination
String mendelF1Generator(String parent1, String parent2) {
  // Extract alleles from each parent
  // Parent format: AABB -> A,A,B,B or AaBb -> A,a,B,b
  char p1_allele1_A = parent1.charAt(0);  // First A locus allele
  char p1_allele2_A = parent1.charAt(1);  // Second A locus allele
  char p1_allele1_B = parent1.charAt(2);  // First B locus allele
  char p1_allele2_B = parent1.charAt(3);  // Second B locus allele
  
  char p2_allele1_A = parent2.charAt(0);  // First A locus allele
  char p2_allele2_A = parent2.charAt(1);  // Second A locus allele
  char p2_allele1_B = parent2.charAt(2);  // First B locus allele
  char p2_allele2_B = parent2.charAt(3);  // Second B locus allele
  
  // Generate the first possible F1 combination
  // Take first allele from each locus of each parent
  String f1_offspring = "";
  
  // For A locus: take first allele from parent1 and first allele from parent2
  f1_offspring += p1_allele1_A;
  f1_offspring += p2_allele1_A;
  
  // For B locus: take first allele from parent1 and first allele from parent2
  f1_offspring += p1_allele1_B;
  f1_offspring += p2_allele1_B;
  
  // Sort alleles within each locus to maintain standard format (dominant first)
  String result = "";
  
  // Sort A locus alleles (A comes before a)
  if (f1_offspring.charAt(0) <= f1_offspring.charAt(1)) {
    result += f1_offspring.charAt(0);
    result += f1_offspring.charAt(1);
  } else {
    result += f1_offspring.charAt(1);
    result += f1_offspring.charAt(0);
  }
  
  // Sort B locus alleles (B comes before b)
  if (f1_offspring.charAt(2) <= f1_offspring.charAt(3)) {
    result += f1_offspring.charAt(2);
    result += f1_offspring.charAt(3);
  } else {
    result += f1_offspring.charAt(3);
    result += f1_offspring.charAt(2);
  }
  
  return result;
}


// Example usage function
void setup() {
  Serial.begin(9600);

  lcd.init();
  // turn on the backlight
  lcd.backlight();

  pinMode(buttonPin,INPUT);
  
  // Test examples
  Serial.println("Mendel F1 Generator Examples:");
  Serial.println("Parent1: AABB, Parent2: aabb -> " + mendelF1Generator("AABB", "aabb"));
  Serial.println("Parent1: AaBb, Parent2: AaBb -> " + mendelF1Generator("AaBb", "AaBb"));
  Serial.println("Parent1: AAbb, Parent2: aaBB -> " + mendelF1Generator("AAbb", "aaBB"));
  Serial.println("Parent1: Aabb, Parent2: AaBb -> " + mendelF1Generator("Aabb", "AaBb"));

  Serial.println("Punnett Square and F2 Ratio Calculator\n");
  
  // Test examples
  printResults("AaBb", "AaBb");  // Should be 9331
  printResults("AABB", "aabb");  // Should be 1000
  printResults("AABb", "AaBb");  // Should be 3100
  printResults("Aabb", "aaBb");  // Should be 1111
  printResults("AABB", "AABB");  // Should be 1000
}

void loop() {

  int buttonState = digitalRead(buttonPin);

  if (buttonState == HIGH && state == 0) {
    state = 1;
    just_changed = true;
  }

  if (just_changed) {
    lcd.clear();

    if (state==0) { 

      // REPLACE THESE WITH USER INPUT
      String input1 = "AABB";
      String input2 = "aabb";

      f1_result = mendelF1Generator(input1,input2);
      //wait  for a second
      delay(1000);
      // tell the screen to write on the top row
      lcd.setCursor(0,0);
      // tell the screen to write “hello, from” on the top  row
      lcd.print("I1:" + input1 + "*" + "I2:" + input2);
      // tell the screen to write on the bottom  row
      lcd.setCursor(0,1);
      // tell the screen to write “Arduino_uno_guy”  on the bottom row
      // you can change whats in the quotes to be what you want  it to be!
      lcd.print("F1= " + f1_result);

      just_changed = false;
      Serial.println(state);
    } else if (state==1) {
      // REPLACE THESE WITH USER INPUT
      String input3 = "AaBb";

      f2_result = calculateF2Ratio(f1_result, input3);
      printResults(f1_result, input3);  // Should be 9331
      //wait  for a second
      delay(1000);
      // tell the screen to write on the top row
      lcd.setCursor(0,0);
      // tell the screen to write “hello, from” on the top  row
      lcd.print("F1:" + f1_result + "*" + "I3:" +  input3);
      // tell the screen to write on the bottom  row
      lcd.setCursor(0,1);
      // tell the screen to write “Arduino_uno_guy”  on the bottom row
      // you can change whats in the quotes to be what you want  it to be!
      lcd.print("F2 ratio=" + f2_result);
    }
    just_changed = false;
    Serial.println(state);
  }
}